
const int note[] = { 
38,39,40,39,38,39,40,39,
38,39,40,39,38,39,40,39,
43,45,45,45,45,45,43,43,43,43,46,46,46,46,46,45,45,45,
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43,47,54,53,47,49,50,50,47,46,45,38,42,43,43,
 };
const int dura[] = {
 2, 2, 2, 2, 2, 2, 2, 2,
 2, 2, 2, 2, 2, 2, 2, 2,
 8,16,16, 8, 8, 8, 8, 8, 8, 8,16,16, 8, 8, 8, 8, 8, 8,
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 8, 4, 8, 4, 8, 8, 8, 2, 4, 4, 8, 8, 8, 8, 1
};



void setup() {
  // put your setup code here, to run once:
  Serial.begin(9600);
  delay(14600);
  insChange(0xC0,0x1b);
  
}

void loop() {
  for (int i = 0; i < 238; i = i + 1) {
    if(i>15){
      insChange(0xC0,0x1b);
      }
      insChange(0xC1,0x12);
      
    noteOn(0x90  ,note[i] , 0x7f);
    noteOn(0x91  ,note[i] , 0x7f);
    delay(1750/dura[i]);
}
delay(1000);
for (int i = 0; i < 238; i = i + 1) {
  insChange(0xC1,0x23);
   noteOn(0x90  ,note[i] , 0x7f);
   noteOn(0x91  ,note[i] , 0x7f);
   delay(1750/dura[i]);
}

}

void noteOn(int cmd, int pitch, int velocity) {
  Serial.write(cmd);
  Serial.write(pitch);
  Serial.write(velocity);
}

void insChange(int cmd,int ins){
  Serial.write(cmd);
  Serial.write(ins);
  }
